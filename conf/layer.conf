## conf/layer.conf
```bitbake
# We have a conf and classes directory, add to BBPATH
BBPATH .= ":${LAYERDIR}"

# We have recipes-* directories, add to BBFILES
BBFILES += "${LAYERDIR}/recipes-*/*/*.bb \
            ${LAYERDIR}/recipes-*/*/*.bbappend"

BBFILE_COLLECTIONS += "meta-wos"
BBFILE_PATTERN_meta-wos = "^${LAYERDIR}/"
BBFILE_PRIORITY_meta-wos = "6"

LAYERDEPENDS_meta-wos = "core"
LAYERSERIES_COMPAT_meta-wos = "scarthgap"
```
